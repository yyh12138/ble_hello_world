## CMakeLists.txt
```
# SPDX-License-Identifier: Apache-2.0

cmake_minimum_required(VERSION 3.20.0)

find_package(Zephyr REQUIRED HINTS $ENV{ZEPHYR_BASE})
project(ci-demo)

target_sources(app PRIVATE src/main.c)

zephyr_library_include_directories(${ZEPHYR_BASE}/sample/bluetooth)
```

## west.yml
```
manifest:
  remotes:
    # 定义一个名为 ncs 的远程源，指向 nrfconnect 的 GitHub
    - name: nrfconnect
      url-base: https://github.com/nrfconnect

  projects:
    - name: sdk-nrf
      remote: nrfconnect
      # 锁定使用的 NCS SDK 版本
      revision: v3.0.1
      path: nrf
      # 'import: true' 会导入 sdk-nrf 文件中定义的所有依赖项 (zephyr, etc.)
      import: true

  # 本项目自身
  self:
    path: .
```

## prj.conf
```kconfig
# Enable Bluetooth
CONFIG_BT=y
CONFIG_BT_PERIPHERAL=y

# Set the device name that can be read by a connected peer.
# Note: This is different from the broadcast name.
CONFIG_BT_DEVICE_NAME="NCS-Hello-World"

# Enable logging
CONFIG_LOG=y
```

## src/main.c
```c
/*
 * Copyright (c) 2023 Nordic Semiconductor ASA
 *
 * SPDX-License-Identifier: Apache-2.0
 */

#include <zephyr/kernel.h>
#include <zephyr/bluetooth/bluetooth.h>
#include <zephyr/bluetooth/hci.h>

// 定义广播数据
// BT_DATA_BYTES：原始数据
// BT_DATA      ：带类型的数据
// 格式为：长度、类型、数据
// 0x02, 0x01, 0x06: Flags (LE General Discoverable Mode, BR/EDR Not Supported)
// 0x0b, 0x09, 'N', 'C', 'S', ' ', 'H', 'e', 'l', 'l', 'o': Complete Local Name "NCS Hello"
static const struct bt_data ad[] = {
	BT_DATA_BYTES(BT_DATA_FLAGS, (BT_LE_AD_GENERAL | BT_LE_AD_NO_BREDR)),
	BT_DATA(BT_DATA_NAME_COMPLETE, "NCS Hello", 9),
};

// 蓝牙协议栈就绪后的回调函数
static void bt_ready(int err)
{
	if (err) {
		printk("Bluetooth init failed (err %d)\n", err);
		return;
	}

	printk("Bluetooth initialized\n");

	// 启动广播
	err = bt_le_adv_start(BT_LE_ADV_CONN_NAME, ad, ARRAY_SIZE(ad), NULL, 0);
	if (err) {
		printk("Advertising failed to start (err %d)\n", err);
		return;
	}

	printk("Advertising successfully started\n");
}

// 主函数
void main(void)
{
	int err;

	printk("Starting BLE Hello World\n");

	// 初始化蓝牙子系统，并注册回调函数
	err = bt_enable(bt_ready);
	if (err) {
		printk("Bluetooth init failed (err %d)\n", err);
	}
}
```
